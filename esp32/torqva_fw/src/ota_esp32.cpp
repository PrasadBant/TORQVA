// ESP32-S3 platform layer for the over-the-air update. See lib/torqva_core/ota.h for the protocol and docs/TORQVA_OTA_FIRMWARE_MANAGER.md for provisioning.
//
// What this file trusts, and from where:
//   * Wi-Fi SSID / password, the HTTPS base URL and the CA certificate come from NVS (namespace "torqva_ota"), written offline by
//     backend/tools/provision_ota.py. They are never received over the serial link, so the backend cannot point the device at another server.
//   * The release signing PUBLIC key is compiled in from src/ota_pubkey.h (generated by backend/tools/sign_firmware.py export-header; git-ignored). Without it
//     this build is not OTA-capable.
//   * TLS: WiFiClientSecure with the provisioned CA. Certificate verification is never disabled (no setInsecure()).
// Bootloader rollback is enabled in this framework's sdkconfig (CONFIG_BOOTLOADER_APP_ROLLBACK_ENABLE=y). verifyRollbackLater() below stops the Arduino core from
// confirming a new image by itself: only a passed self-test does (esp_ota_mark_app_valid_cancel_rollback), a failure marks it invalid and restarts into the previous image.
#include "ota_esp32.h"
#include <WiFi.h>
#include <WiFiClientSecure.h>
#include <HTTPClient.h>
#include <Update.h>
#include <Preferences.h>
#include <esp_ota_ops.h>
#include <esp_partition.h>
#include <mbedtls/pk.h>
#include <mbedtls/base64.h>
#include "sha256.h"
#include "config_pins.h"

#if __has_include("ota_pubkey.h")
#include "ota_pubkey.h"            // defines TORQVA_OTA_PUBKEY_PEM (PEM text of the ECDSA P-256 public key)
#define TORQVA_OTA_HAVE_KEY 1
#else
#define TORQVA_OTA_HAVE_KEY 0
#endif

using namespace torqva;

// The Arduino core confirms a pending image at start-up unless this returns true. TORQVA confirms only after its own self-test.
extern "C" bool verifyRollbackLater() { return true; }

namespace {

const char* kNs = "torqva_ota";
const uint32_t kWifiTimeoutMs = 20000;
const uint32_t kReadTimeoutMs = 15000;
const uint32_t kSelfTestWindowMs = 120000;      // the host must re-establish the authenticated session within this time after the restart

String g_ssid, g_pass, g_base, g_ca;
const char* g_why = "OTA_NOT_CONFIGURED";
bool g_capable = false;
Device* g_dev = nullptr;
SemaphoreHandle_t g_mu = nullptr;
bool g_ina_ok = false, g_temp_ok = false, g_key_ok = false;
void (*g_outputs_off)() = nullptr;
char g_last[16] = "", g_last_ver[24] = "", g_att_ver[24] = "";

bool base_url_ok(const String& u) {
    if (!u.startsWith("https://")) return false;                       // never plain HTTP
    String host = u.substring(8);
    const int slash = host.indexOf('/'); if (slash >= 0) host = host.substring(0, slash);
    const int colon = host.lastIndexOf(':'); if (colon > 0 && host[0] != '[') host = host.substring(0, colon);
    host.toLowerCase();
    if (host.length() == 0 || host == "localhost" || host.startsWith("127.") || host == "0.0.0.0" || host.startsWith("[::1]") || host == "::1") return false;   // not device-reachable
    return true;
}

const char* running_name(const esp_partition_t* p) {
    if (!p) return "?";
    if (p->subtype == ESP_PARTITION_SUBTYPE_APP_OTA_0) return "ota_0";
    if (p->subtype == ESP_PARTITION_SUBTYPE_APP_OTA_1) return "ota_1";
    if (p->subtype == ESP_PARTITION_SUBTYPE_APP_FACTORY) return "factory";
    return "?";
}

bool pending_verify() {
    esp_ota_img_states_t st;
    const esp_partition_t* run = esp_ota_get_running_partition();
    return run && esp_ota_get_state_partition(run, &st) == ESP_OK && st == ESP_OTA_IMG_PENDING_VERIFY;
}

class EspOtaPort : public OtaPort {
public:
    bool wifi_connect() override {
        WiFi.mode(WIFI_STA);
        WiFi.begin(g_ssid.c_str(), g_pass.c_str());
        const uint32_t t0 = millis();
        while (WiFi.status() != WL_CONNECTED) { if (millis() - t0 > kWifiTimeoutMs) return false; delay(100); }
        return true;
    }
    void wifi_disconnect() override { http_.end(); WiFi.disconnect(true); WiFi.mode(WIFI_OFF); }      // Wi-Fi is on only during an update
    bool fetch_manifest(const OtaRequest& r, char* out, size_t cap) override {
        if (!get(r, "manifest")) return false;
        String body = http_.getString(); http_.end();
        if (body.length() + 1 > cap) return false;
        memcpy(out, body.c_str(), body.length() + 1);
        return true;
    }
    bool open_image(const OtaRequest& r, uint32_t* len) override {
        if (!get(r, "image")) return false;
        const int n = http_.getSize();
        if (n <= 0) { http_.end(); return false; }
        *len = (uint32_t)n; left_ = (uint32_t)n;
        return true;
    }
    int read_image(uint8_t* buf, size_t n) override {
        if (left_ == 0) return 0;
        WiFiClient* s = http_.getStreamPtr();
        if (!s) return -1;
        const uint32_t t0 = millis();
        for (;;) {
            const size_t avail = (size_t)s->available();
            if (avail) {
                size_t k = n < avail ? n : avail; if (k > left_) k = left_;
                const int r = s->read(buf, k);
                if (r < 0) return -1;
                left_ -= (uint32_t)r; return r;
            }
            if (!http_.connected()) return -1;                        // closed before every announced byte arrived
            if (millis() - t0 > kReadTimeoutMs) return -1;
            delay(5);
        }
    }
    void close_image() override { http_.end(); }
    uint32_t inactive_partition_size() override { const esp_partition_t* p = esp_ota_get_next_update_partition(nullptr); return p ? p->size : 0; }
    bool flash_begin(uint32_t size) override { return Update.begin(size, U_FLASH); }        // the next OTA partition, never the running one
    bool flash_write(const uint8_t* b, size_t n) override { return Update.write(const_cast<uint8_t*>(b), n) == n; }
    bool flash_finish_and_select() override { return Update.end(true) && Update.isFinished(); }   // esp_image verification, then esp_ota_set_boot_partition
    void flash_abort() override { Update.abort(); }
    bool verify_signature(const char* message, const char* sig_b64) override {
#if TORQVA_OTA_HAVE_KEY
        uint8_t sig[128]; size_t sig_len = 0;
        if (mbedtls_base64_decode(sig, sizeof(sig), &sig_len, (const unsigned char*)sig_b64, strlen(sig_b64)) != 0) return false;
        uint8_t h[32]; torqva::sha256(message, strlen(message), h);
        mbedtls_pk_context pk; mbedtls_pk_init(&pk);
        bool ok = mbedtls_pk_parse_public_key(&pk, (const unsigned char*)TORQVA_OTA_PUBKEY_PEM, strlen(TORQVA_OTA_PUBKEY_PEM) + 1) == 0
                  && mbedtls_pk_can_do(&pk, MBEDTLS_PK_ECKEY)
                  && mbedtls_pk_verify(&pk, MBEDTLS_MD_SHA256, h, sizeof(h), sig, sig_len) == 0;
        mbedtls_pk_free(&pk);
        return ok;
#else
        (void)message; (void)sig_b64;
        return false;                                                 // no key compiled in: nothing can be authenticated
#endif
    }
    bool record_attempt(const char* rel, const char* ver) override {
        Preferences p;
        if (!p.begin(kNs, false)) return false;
        const bool ok = p.putString("att_rel", rel) > 0 && p.putString("att_ver", ver) > 0;
        p.end();
        return ok;
    }
    void restart() override {
        if (g_outputs_off) g_outputs_off();
        delay(600);                                                   // let the queued READY / REBOOTING lines reach the host
        ESP.restart();
    }
private:
    bool get(const OtaRequest& r, const char* what) {
        cli_.setCACert(g_ca.c_str());                                 // TLS verified against the provisioned CA; hostname checked by mbedTLS
        cli_.setTimeout(kReadTimeoutMs / 1000);
        String url = g_base;
        if (url.endsWith("/")) url.remove(url.length() - 1);
        url += "/api/torqva/firmware/ota/"; url += r.rel; url += "/"; url += what; url += "?t="; url += r.tok;
        if (!http_.begin(cli_, url)) return false;
        http_.setReuse(false);
        const int code = http_.GET();
        if (code != 200) { http_.end(); return false; }
        return true;
    }
    WiFiClientSecure cli_;
    HTTPClient http_;
    uint32_t left_ = 0;
};

EspOtaPort g_port;

void sink(const OtaProgress& p, void*) {
    if (xSemaphoreTake(g_mu, pdMS_TO_TICKS(50)) == pdTRUE) { g_dev->ota_progress(p); xSemaphoreGive(g_mu); }    // never blocks the control task for long
}

void persist_last(const char* result, const char* ver, bool clear_attempt) {
    Preferences p;
    if (!p.begin(kNs, false)) return;
    p.putString("last", result); p.putString("lver", ver);
    if (clear_attempt) { p.remove("att_rel"); p.remove("att_ver"); }
    p.end();
}

void self_test() {
    if (xSemaphoreTake(g_mu, portMAX_DELAY) == pdTRUE) { g_dev->ota_boot_result(OtaState::SELF_TEST, ""); xSemaphoreGive(g_mu); }
    const uint32_t t0 = millis();
    bool link = false;
    while (!link && millis() - t0 < kSelfTestWindowMs) {
        delay(250);
        if (xSemaphoreTake(g_mu, pdMS_TO_TICKS(50)) == pdTRUE) { link = g_dev->secure_session(); xSemaphoreGive(g_mu); }    // the authenticated host link is back
    }
    SelfTestInputs s = {};
    if (xSemaphoreTake(g_mu, portMAX_DELAY) == pdTRUE) {
        s.device_initialised = true;
        s.sensors_initialised = g_ina_ok && g_temp_ok;
        s.identity_and_key = g_key_ok;
        s.host_link = link;
        s.safety_initialised = g_dev->safety().state() != SafetyState::EMERGENCY_STOP;
        s.estop_input_read = g_dev->estop_state() != 3;
        s.outputs_disabled = g_dev->outputs_off();
        s.watchdog_active = g_dev->watchdog_active();
        s.ota_healthy = g_capable;
        xSemaphoreGive(g_mu);
    }
    const char* why = ota_selftest(s);
    if (!why && esp_ota_mark_app_valid_cancel_rollback() == ESP_OK) {
        persist_last("CONFIRMED", TORQVA_FW_VERSION, true);
        if (xSemaphoreTake(g_mu, portMAX_DELAY) == pdTRUE) { g_dev->ota_boot_result(OtaState::CONFIRMED, ""); xSemaphoreGive(g_mu); }
        return;
    }
    if (!why) why = "CONFIRM_FAILED";
    if (xSemaphoreTake(g_mu, portMAX_DELAY) == pdTRUE) { g_dev->ota_boot_result(OtaState::ROLLBACK, why); xSemaphoreGive(g_mu); }
    delay(600);
    if (g_outputs_off) g_outputs_off();
    esp_ota_mark_app_invalid_rollback_and_reboot();                   // the bootloader starts the previous image (the next boot reports ROLLED_BACK)
}

void ota_task(void*) {
    if (pending_verify()) self_test();
    for (;;) {
        OtaRequest r; bool have = false;
        if (xSemaphoreTake(g_mu, pdMS_TO_TICKS(50)) == pdTRUE) { have = g_dev->take_ota_request(&r); xSemaphoreGive(g_mu); }
        if (have) ota_run(r, TORQVA_FW_VERSION, g_port, sink, nullptr);     // returns only on failure (success restarts the chip)
        delay(200);
    }
}

}  // namespace

void ota_platform_capability(DeviceConfig& cfg) {
    const esp_partition_t* run = esp_ota_get_running_partition();
    const esp_partition_t* next = esp_ota_get_next_update_partition(nullptr);
    const esp_partition_t* otad = esp_partition_find_first(ESP_PARTITION_TYPE_DATA, ESP_PARTITION_SUBTYPE_DATA_OTA, nullptr);
    Preferences p;
    if (p.begin(kNs, true)) {
        g_ssid = p.getString("ssid", ""); g_pass = p.getString("pass", ""); g_base = p.getString("base", ""); g_ca = p.getString("ca", "");
        p.end();
    }
    if (!otad || !next || !run || (run->subtype != ESP_PARTITION_SUBTYPE_APP_OTA_0 && run->subtype != ESP_PARTITION_SUBTYPE_APP_OTA_1)) g_why = "NO_OTA_PARTITIONS";
    else if (!TORQVA_OTA_HAVE_KEY) g_why = "NO_SIGNING_KEY";
    else if (g_ssid.length() == 0) g_why = "NO_WIFI_CONFIG";
    else if (!base_url_ok(g_base)) g_why = "NO_HTTPS_BASE_URL";
    else if (g_ca.indexOf("-----BEGIN CERTIFICATE-----") < 0) g_why = "NO_CA_CERT";
    else { g_why = ""; g_capable = true; }
    cfg.ota_capable = g_capable;
    cfg.ota_why = g_why;
}

void ota_platform_start(Device* dev, SemaphoreHandle_t mu, bool ina_ok, bool temp_ok, bool identity_ok, void (*outputs_off)()) {
    g_dev = dev; g_mu = mu; g_ina_ok = ina_ok; g_temp_ok = temp_ok; g_key_ok = identity_ok; g_outputs_off = outputs_off;
    bool attempt = false; String att_ver, last, lver;
    {
        Preferences p;
        if (p.begin(kNs, true)) {
            att_ver = p.getString("att_ver", ""); attempt = att_ver.length() > 0;
            last = p.getString("last", ""); lver = p.getString("lver", "");
            p.end();
        }
    }
    const bool pend = pending_verify();
    switch (ota_boot_outcome(attempt, att_ver.c_str(), TORQVA_FW_VERSION, pend)) {
        case BootOutcome::ROLLED_BACK: persist_last("ROLLED_BACK", att_ver.c_str(), true); last = "ROLLED_BACK"; lver = att_ver; break;
        case BootOutcome::CONFIRMED: persist_last("CONFIRMED", TORQVA_FW_VERSION, true); last = "CONFIRMED"; lver = TORQVA_FW_VERSION; break;
        default: break;                                                // SELF_TEST runs in the OTA task; NONE changes nothing
    }
    strncpy(g_last, last.c_str(), sizeof(g_last) - 1); strncpy(g_last_ver, lver.c_str(), sizeof(g_last_ver) - 1); strncpy(g_att_ver, att_ver.c_str(), sizeof(g_att_ver) - 1);
    const esp_partition_t* next = esp_ota_get_next_update_partition(nullptr);
    dev->set_ota_boot(running_name(esp_ota_get_running_partition()), next ? next->size : 0, pend, g_last, g_last_ver);
    // TLS + HTTP need a large stack; lower priority than the control task, on the other core.
    xTaskCreatePinnedToCore(ota_task, "ota", 12288, nullptr, 1, nullptr, 0);
}
